## br2/configs/mfi_defconfig
```kconfig
BR2_mips=y
BR2_TOOLCHAIN_BUILDROOT_UCLIBC=y
BR2_UCLIBC_CONFIG="$(BR2_EXTERNAL_mFi_PATH)/board/ubiquiti/mfi/uclibc.config"
BR2_BINUTILS_VERSION_2_42_X=y
BR2_GCC_VERSION_14_X=y
BR2_TOOLCHAIN_BUILDROOT_CXX=y
BR2_DL_DIR="$(BASE_DIR)/dl"
BR2_OPTIMIZE_S=y
BR2_STATIC_LIBS=y
BR2_INIT_NONE=y
BR2_SYSTEM_BIN_SH_NONE=y
BR2_PACKAGE_JSON_FOR_MODERN_CPP=y
BR2_PACKAGE_MONGOOSE=y
BR2_PACKAGE_CLI11=y
BR2_PACKAGE_MOSQUITTO=y
```
